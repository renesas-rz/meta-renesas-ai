## bsp-fixes/meta-rzg2/conf/layer.conf
```bitbake
#We have a conf and classes directory, append to BBPATH
BBPATH .= ":${LAYERDIR}"

# We have a recipes directory, add to BBFILES
BBFILES += " \
        ${LAYERDIR}/recipes-*/*/*.bb \
        ${LAYERDIR}/recipes-*/*/*.bbappend \
"

BBFILE_COLLECTIONS += "bsp-fixes-rzg2-layer"
BBFILE_PATTERN_bsp-fixes-rzg2-layer := "^${LAYERDIR}/"
BBFILE_PRIORITY_bsp-fixes-rzg2-layer = "5"

LAYERSERIES_COMPAT_bsp-fixes-rzg2-layer = "rocko"
```

## conf/layer.conf
```bitbake
#We have a conf and classes directory, append to BBPATH
BBPATH .= ":${LAYERDIR}"

# We have a recipes directory, add to BBFILES
BBFILES += " \
        ${LAYERDIR}/recipes-*/*/*.bb \
        ${LAYERDIR}/recipes-*/*/*.bbappend \
"

BBFILE_COLLECTIONS += "renesas-ai-layer"
BBFILE_PATTERN_renesas-ai-layer := "^${LAYERDIR}/"
BBFILE_PRIORITY_renesas-ai-layer = "5"

LAYERSERIES_COMPAT_renesas-ai-layer = "dunfell"

PREFERRED_VERSION_arm-compute-library ?= "24.06%"
PREFERRED_VERSION_armnn ?= "24.05%"
PREFERRED_VERSION_flatbuffers ?= "23.5.26%"
PREFERRED_VERSION_onnxruntime ?= "1.8.0%"
PREFERRED_VERSION_protobuf ?= "3.12.4%"
PREFERRED_VERSION_protobuf-native ?= "3.12.4%"
PREFERRED_VERSION_protobuf3.16.0-native ?= "3.16.0%"
PREFERRED_VERSION_python3-cython-native = "0.29.32"
PREFERRED_VERSION_python3-numpy = "1.23.3"
PREFERRED_VERSION_tensorflow-lite ?= "2.15.1"
```

## meta-armnn/conf/layer.conf
```bitbake
#We have a conf and classes directory, append to BBPATH
BBPATH .= ":${LAYERDIR}"

# We have a recipes directory, add to BBFILES
BBFILES += " \
        ${LAYERDIR}/recipes-*/*/*.bb \
        ${LAYERDIR}/recipes-*/*/*.bbappend \
"

BBFILE_COLLECTIONS += "armnn-layer"
BBFILE_PATTERN_armnn-layer := "^${LAYERDIR}/"
BBFILE_PRIORITY_armnn-layer = "9"
LAYERSERIES_COMPAT_armnn-layer = "dunfell"

PREFERRED_VERSION_arm-compute-library ?= "22.02%"
PREFERRED_VERSION_armnn ?= "22.02%"
PREFERRED_VERSION_protobuf-native ?= "3.12.4%"
PREFERRED_VERSION_protobuf ?= "3.12.4%"
PREFERRED_VERSION_boost ?= "1.64.0%"
PREFERRED_VERSION_flatbuffers ?= "1.12.0%"
PREFERRED_VERSION_tensorflow-lite ?= "2.5.3"
```

## meta-benchmark/conf/layer.conf
```bitbake
#We have a conf and classes directory, append to BBPATH
BBPATH .= ":${LAYERDIR}"

# We have a recipes directory, add to BBFILES
BBFILES += " \
        ${LAYERDIR}/recipes-*/*/*.bb \
        ${LAYERDIR}/recipes-*/*/*.bbappend \
"

BBFILE_COLLECTIONS += "benchmark-layer"
BBFILE_PATTERN_benchmark-layer := "^${LAYERDIR}/"
BBFILE_PRIORITY_benchmark-layer = "8"
LAYERSERIES_COMPAT_benchmark-layer = "rocko dunfell"
```

## meta-caffe2/conf/layer.conf
```bitbake
#We have a conf and classes directory, append to BBPATH
BBPATH .= ":${LAYERDIR}"

# We have a recipes directory, add to BBFILES
BBFILES += " \
        ${LAYERDIR}/recipes-*/*/*.bb \
        ${LAYERDIR}/recipes-*/*/*.bbappend \
"

BBFILE_COLLECTIONS += "caffe2-layer"
BBFILE_PATTERN_caffe2-layer := "^${LAYERDIR}/"
BBFILE_PRIORITY_caffe2-layer = "8"

PREFERRED_VERSION_python-numpy ?= "1.13.1%"
PREFERRED_VERSION_gflags ?= "2.2.1%"
PREFERRED_VERSION_glog ?= "0.3.5%"
PREFERRED_VERSION_protobuf-native ?= "3.6.0%"
PREFERRED_VERSION_protobuf ?= "3.6.0%"
PREFERRED_VERSION_python-protobuf = "3.6.0%"
PREFERRED_VERSION_python-future = "0.16.0%"
PREFERRED_VERSION_python-setuptools = "18.7.1%"
PREFERRED_VERSION_caffe2 ?= "0.8.1%"
```

## meta-onnxruntime/conf/layer.conf
```bitbake
#We have a conf and classes directory, append to BBPATH
BBPATH .= ":${LAYERDIR}"

# We have a recipes directory, add to BBFILES
BBFILES += " \
        ${LAYERDIR}/recipes-*/*/*.bb \
        ${LAYERDIR}/recipes-*/*/*.bbappend \
"

BBFILE_COLLECTIONS += "onnxruntime"
BBFILE_PATTERN_onnxruntime = "^${LAYERDIR}/"
BBFILE_PRIORITY_onnxruntime = "8"
LAYERSERIES_COMPAT_onnxruntime = "rocko dunfell"

PREFERRED_VERSION_protobuf3.16.0-native ?= "3.16.0%"
PREFERRED_VERSION_cmake-native ?= "3.14.1%"
PREFERRED_VERSION_onnxruntime ?= "1.8.0%"
```

## meta-opencv/conf/layer.conf
```bitbake
#We have a conf and classes directory, append to BBPATH
BBPATH .= ":${LAYERDIR}"

# We have a recipes directory, add to BBFILES
BBFILES += " \
        ${LAYERDIR}/recipes-*/*/*.bb \
        ${LAYERDIR}/recipes-*/*/*.bbappend \
"

BBFILE_COLLECTIONS += "opencv-layer"
BBFILE_PATTERN_opencv-layer := "^${LAYERDIR}/"
BBFILE_PRIORITY_opencv-layer = "8"

PREFERRED_VERSION_opencv ?= "4.1.1%"
PREFERRED_VERSION_protobuf-native ?= "3.6.0%"
PREFERRED_VERSION_protobuf ?= "3.6.0%"
```

## meta-pytorch/conf/layer.conf
```bitbake
# We have a conf and classes directory, add to BBPATH
BBPATH .= ":${LAYERDIR}"

# We have recipes-* directories, add to BBFILES
BBFILES += "${LAYERDIR}/recipes-*/*/*.bb \
	${LAYERDIR}/recipes-*/*/*.bbappend"

BBFILE_COLLECTIONS += "pytorch"
BBFILE_PATTERN_pytorch= "^${LAYERDIR}/"
BBFILE_PRIORITY_pytorch= "6"

PREFERRED_VERSION_protobuf-native ?= "3.6.0%"
PREFERRED_VERSION_protobuf ?= "3.6.0%"

META_PYTORCH_DIR = "${LAYERDIR}"
```

## meta-rzg-ai/conf/layer.conf
```bitbake
#We have a conf and classes directory, append to BBPATH
BBPATH .= ":${LAYERDIR}"

# We have a recipes directory, add to BBFILES
BBFILES += " \
        ${LAYERDIR}/recipes-*/*/*.bb \
        ${LAYERDIR}/recipes-*/*/*.bbappend \
"

BBFILE_COLLECTIONS += "rzg-ai-layer"
BBFILE_PATTERN_rzg-ai-layer := "^${LAYERDIR}/"
BBFILE_PRIORITY_rzg-ai-layer = "7"

LAYERSERIES_COMPAT_rzg-ai-layer = "rocko dunfell"
```

## meta-rzg-ai/wic/sdimage-rootfs.wks
```
# short-description: Create SD card image with a rootfs
# long-description: Creates a single partitioned SD card image with
# a root filesystem

part / --source rootfs --ondisk mmcblk --fstype=ext4 --label root --align 4
```

## meta-rzg1-gcc-linaro/conf/layer.conf
```bitbake
#i We have a conf and classes directory, append to BBPATH
BBPATH .= ":${LAYERDIR}"

# We have a recipes directory, add to BBFILES
BBFILES += " \
        ${LAYERDIR}/gcc-linaro*/*.bb \
        ${LAYERDIR}/gcc-linaro*/*.bbappend \
"

BBFILE_COLLECTIONS += "rzg1-gcc-linaro-layer"
BBFILE_PATTERN_rzg1-gcc-linaro-layer := "^${LAYERDIR}/"
BBFILE_PRIORITY_rzg1-gcc-linaro-layer = "8"

# Intended for use with Tensorflow 2.3.1 only
PREFERRED_VERSION_bazel-native ?= "3.5.0"
PREFERRED_VERSION_tensorflow ?= "2.3.1%"
PREFERRED_VERSION_libeigen ?= "3.3.2"
```

## meta-tensorflow-lite/conf/layer.conf
```bitbake
#We have a conf and classes directory, append to BBPATH
BBPATH .= ":${LAYERDIR}"

# We have a recipes directory, add to BBFILES
BBFILES += " \
        ${LAYERDIR}/recipes-*/*/*.bb \
        ${LAYERDIR}/recipes-*/*/*.bbappend \
"

BBFILE_COLLECTIONS += "tensorflow-lite-layer"
BBFILE_PATTERN_tensorflow-lite-layer := "^${LAYERDIR}/"
BBFILE_PRIORITY_tensorflow-lite-layer = "8"
LAYERSERIES_COMPAT_tensorflow-lite-layer = "dunfell"

PREFERRED_VERSION_tensorflow-lite ?= "2.5.3"
```

## meta-tensorflow/conf/layer.conf
```bitbake
#We have a conf and classes directory, append to BBPATH
BBPATH .= ":${LAYERDIR}"

# We have a recipes directory, add to BBFILES
BBFILES += " \
        ${LAYERDIR}/recipes-*/*/*.bb \
        ${LAYERDIR}/recipes-*/*/*.bbappend \
"

BBFILE_COLLECTIONS += "tensorflow-layer"
BBFILE_PATTERN_tensorflow-layer := "^${LAYERDIR}/"
BBFILE_PRIORITY_tensorflow-layer = "8"

PREFERRED_VERSION_openjdk-8-native ?= "151-1.b12"
PREFERRED_VERSION_bazel-native ?= "0.5.2"
PREFERRED_VERSION_tensorflow ?= "1.2%"
PREFERRED_VERSION_libeigen ?= "3.3.2"
PREFERRED_VERSION_protobuf ?= "3.2.0%"
```
